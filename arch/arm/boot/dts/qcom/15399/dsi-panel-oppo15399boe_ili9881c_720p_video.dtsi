/* Copyright (c) 2020, The Linux Foundation. All rights reserved.
*  Copyright (c) 2020, the_shahnawaz_sheikh (sheikhshahnawaz41299).
*
* This program is free software; you can redistribute it and/or modify
* it under the terms of the GNU General Public License version 2 and
* only version 2 as published by the Free Software Foundation.
*
* This program is distributed in the hope that it will be useful,
* but WITHOUT ANY WARRANTY; without even the implied warranty of
* MERCHANTABILITY or FITNESS FOR A PARTICULAR PURPOSE.  See the
* GNU General Public License for more details.
*/

&mdss_mdp {
		dsi_oppo15399boe_ili9881c_720p_video:	qcom,mdss_dsi_oppo15399boe_ili9881c_720p_video {
				qcom,mdss-dsi-panel-name = "oppo15399boe ili9881c 720p video mode dsi panel";
				qcom,mdss-dsi-panel-manufacture = "Boe_0415";
				qcom,mdss-dsi-panel-version = "ILI9881C";
				qcom,mdss-dsi-panel-controller = <&mdss_dsi0>;
				qcom,mdss-dsi-panel-type = "dsi_video_mode";
				qcom,mdss-dsi-panel-destination = "display_1";
				qcom,mdss-dsi-panel-framerate = <60>;
				qcom,mdss-dsi-virtual-channel-id = <0x0>;
				qcom,mdss-dsi-stream = <0x0>;
				qcom,mdss-dsi-panel-width = <720>;
				qcom,mdss-dsi-panel-height = <1280>;
				qcom,mdss-dsi-h-front-porch = <164>;
				qcom,mdss-dsi-h-back-porch = <160>;
				qcom,mdss-dsi-h-pulse-width = <2>;
				qcom,mdss-dsi-h-sync-skew = <0>;
				qcom,mdss-dsi-v-back-porch = <24>;
				qcom,mdss-dsi-v-front-porch = <24>;
				qcom,mdss-dsi-v-pulse-width = <8>;
				qcom,mdss-dsi-h-left-border = <0>;
				qcom,mdss-dsi-h-right-border = <0>;
				qcom,mdss-dsi-v-top-border = <0>;
				qcom,mdss-dsi-v-bottom-border = <0>;
				qcom,mdss-dsi-bpp = <24>;
				qcom,mdss-dsi-color-order = "rgb_swap_rgb";
				qcom,mdss-dsi-underflow-color = <255>;
				qcom,mdss-dsi-border-color = <0>;
				qcom,mdss-dsi-pixel-packing = "tight";
				qcom,mdss-dsi-on-command = [39 01 00 00 00 00 04 ff 98 81 03 39 01 00 00 00 00 02 01 00 39 01 00 00 00 00 02 02 00 39 01 00 00 00 00 02 03 73 39 01 00 00 00 00 02 04 00 39 01 00 00 00 00 02 05 00 39 01 00 00 00 00 02 06 08 39 01 00 00 00 00 02 07 00 39 01 00 00 00 00 02 08 00 39 01 00 00 00 00 02 09 1b 39 01 00 00 00 00 02 0a 01 39 01 00 00 00 00 02 0b 01 39 01 00 00 00 00 02 0c 0d 39 01 00 00 00 00 02 0d 01 39 01 00 00 00 00 02 0e 01 39 01 00 00 00 00 02 0f 26 39 01 00 00 00 00 02 10 26 39 01 00 00 00 00 02 11 00 39 01 00 00 00 00 02 12 00 39 01 00 00 00 00 02 13 02 39 01 00 00 00 00 02 14 00 39 01 00 00 00 00 02 15 00 39 01 00 00 00 00 02 16 00 39 01 00 00 00 00 02 17 00 39 01 00 00 00 00 02 18 00 39 01 00 00 00 00 02 19 00 39 01 00 00 00 00 02 1a 00 39 01 00 00 00 00 02 1b 00 39 01 00 00 00 00 02 1c 00 39 01 00 00 00 00 02 1d 00 39 01 00 00 00 00 02 1e 40 39 01 00 00 00 00 02 1f 00 39 01 00 00 00 00 02 20 06 39 01 00 00 00 00 02 21 01 39 01 00 00 00 00 02 22 00 39 01 00 00 00 00 02 23 00 39 01 00 00 00 00 02 24 00 39 01 00 00 00 00 02 25 00 39 01 00 00 00 00 02 26 00 39 01 00 00 00 00 02 27 00 39 01 00 00 00 00 02 28 33 39 01 00 00 00 00 02 29 03 39 01 00 00 00 00 02 2a 00 39 01 00 00 00 00 02 2b 00 39 01 00 00 00 00 02 2c 00 39 01 00 00 00 00 02 2d 00 39 01 00 00 00 00 02 2e 00 39 01 00 00 00 00 02 2f 00 39 01 00 00 00 00 02 30 00 39 01 00 00 00 00 02 31 00 39 01 00 00 00 00 02 32 00 39 01 00 00 00 00 02 33 00 39 01 00 00 00 00 02 34 00 39 01 00 00 00 00 02 35 00 39 01 00 00 00 00 02 36 00 39 01 00 00 00 00 02 37 00 39 01 00 00 00 00 02 38 00 39 01 00 00 00 00 02 39 00 39 01 00 00 00 00 02 3a 00 39 01 00 00 00 00 02 3b 00 39 01 00 00 00 00 02 3c 00 39 01 00 00 00 00 02 3d 00 39 01 00 00 00 00 02 3e 00 39 01 00 00 00 00 02 3f 00 39 01 00 00 00 00 02 40 00 39 01 00 00 00 00 02 41 00 39 01 00 00 00 00 02 42 00 39 01 00 00 00 00 02 43 00 39 01 00 00 00 00 02 44 00 39 01 00 00 00 00 02 50 01 39 01 00 00 00 00 02 51 23 39 01 00 00 00 00 02 52 45 39 01 00 00 00 00 02 53 67 39 01 00 00 00 00 02 54 89 39 01 00 00 00 00 02 55 ab 39 01 00 00 00 00 02 56 01 39 01 00 00 00 00 02 57 23 39 01 00 00 00 00 02 58 45 39 01 00 00 00 00 02 59 67 39 01 00 00 00 00 02 5a 89 39 01 00 00 00 00 02 5b ab 39 01 00 00 00 00 02 5c cd 39 01 00 00 00 00 02 5d ef 39 01 00 00 00 00 02 5e 11 39 01 00 00 00 00 02 5f 02 39 01 00 00 00 00 02 60 00 39 01 00 00 00 00 02 61 07 39 01 00 00 00 00 02 62 06 39 01 00 00 00 00 02 63 0e 39 01 00 00 00 00 02 64 0f 39 01 00 00 00 00 02 65 0c 39 01 00 00 00 00 02 66 0d 39 01 00 00 00 00 02 67 02 39 01 00 00 00 00 02 68 02 39 01 00 00 00 00 02 69 02 39 01 00 00 00 00 02 6a 02 39 01 00 00 00 00 02 6b 02 39 01 00 00 00 00 02 6c 02 39 01 00 00 00 00 02 6d 02 39 01 00 00 00 00 02 6e 02 39 01 00 00 00 00 02 6f 02 39 01 00 00 00 00 02 70 02 39 01 00 00 00 00 02 71 02 39 01 00 00 00 00 02 72 02 39 01 00 00 00 00 02 73 05 39 01 00 00 00 00 02 74 01 39 01 00 00 00 00 02 75 02 39 01 00 00 00 00 02 76 00 39 01 00 00 00 00 02 77 07 39 01 00 00 00 00 02 78 06 39 01 00 00 00 00 02 79 0e 39 01 00 00 00 00 02 7a 0f 39 01 00 00 00 00 02 7b 0c 39 01 00 00 00 00 02 7c 0d 39 01 00 00 00 00 02 7d 02 39 01 00 00 00 00 02 7e 02 39 01 00 00 00 00 02 7f 02 39 01 00 00 00 00 02 80 02 39 01 00 00 00 00 02 81 02 39 01 00 00 00 00 02 82 02 39 01 00 00 00 00 02 83 02 39 01 00 00 00 00 02 84 02 39 01 00 00 00 00 02 85 02 39 01 00 00 00 00 02 86 02 39 01 00 00 00 00 02 87 02 39 01 00 00 00 00 02 88 02 39 01 00 00 00 00 02 89 05 39 01 00 00 00 00 02 8a 01 39 01 00 00 00 00 04 ff 98 81 04 39 01 00 00 00 00 02 00 00 39 01 00 00 00 00 02 0b 80 39 01 00 00 00 00 02 0e 17 39 01 00 00 00 00 02 6c 15 39 01 00 00 00 00 02 6e 1a 39 01 00 00 00 00 02 6f 25 39 01 00 00 00 00 02 3a a4 39 01 00 00 00 00 02 8d 2a 39 01 00 00 00 00 02 87 ba 39 01 00 00 00 00 02 3b 80 39 01 00 00 00 00 02 7a 10 39 01 00 00 00 00 02 71 b0 39 01 00 00 00 00 04 ff 98 81 01 39 01 00 00 00 00 02 22 0a 39 01 00 00 00 00 02 53 7d 39 01 00 00 00 00 02 55 8a 39 01 00 00 00 00 02 50 85 39 01 00 00 00 00 02 51 82 39 01 00 00 00 00 02 31 00 39 01 00 00 00 00 02 40 33 39 01 00 00 00 00 02 43 66 39 01 00 00 00 00 02 60 19 39 01 00 00 00 00 02 61 01 39 01 00 00 00 00 02 62 0c 39 01 00 00 00 00 02 63 00 39 01 00 00 00 00 04 ff 98 81 05 39 01 00 00 00 00 02 80 01 39 01 00 00 00 00 04 ff 98 81 01 39 01 00 00 00 00 02 34 01 39 01 00 00 00 00 02 a0 06 39 01 00 00 00 00 02 a1 13 39 01 00 00 00 00 02 a2 21 39 01 00 00 00 00 02 a3 11 39 01 00 00 00 00 02 a4 15 39 01 00 00 00 00 02 a5 23 39 01 00 00 00 00 02 a6 1a 39 01 00 00 00 00 02 a7 1c 39 01 00 00 00 00 02 a8 77 39 01 00 00 00 00 02 a9 1c 39 01 00 00 00 00 02 aa 29 39 01 00 00 00 00 02 ab 6f 39 01 00 00 00 00 02 ac 13 39 01 00 00 00 00 02 ad 0d 39 01 00 00 00 00 02 ae 3d 39 01 00 00 00 00 02 af 0a 39 01 00 00 00 00 02 b0 18 39 01 00 00 00 00 02 b1 61 39 01 00 00 00 00 02 b2 74 39 01 00 00 00 00 02 b3 39 39 01 00 00 00 00 02 c0 05 39 01 00 00 00 00 02 c1 12 39 01 00 00 00 00 02 c2 20 39 01 00 00 00 00 02 c3 12 39 01 00 00 00 00 02 c4 15 39 01 00 00 00 00 02 c5 24 39 01 00 00 00 00 02 c6 1a 39 01 00 00 00 00 02 c7 1c 39 01 00 00 00 00 02 c8 76 39 01 00 00 00 00 02 c9 1c 39 01 00 00 00 00 02 ca 29 39 01 00 00 00 00 02 cb 6e 39 01 00 00 00 00 02 cc 13 39 01 00 00 00 00 02 cd 0d 39 01 00 00 00 00 02 ce 3d 39 01 00 00 00 00 02 cf 0a 39 01 00 00 00 00 02 d0 19 39 01 00 00 00 00 02 d1 60 39 01 00 00 00 00 02 d2 73 39 01 00 00 00 00 02 d3 39 39 01 00 00 00 00 04 ff 98 81 05 39 01 00 00 00 00 02 00 00 39 01 00 00 00 00 02 01 00 39 01 00 00 00 00 02 02 00 39 01 00 00 00 00 02 03 00 39 01 00 00 00 00 02 04 00 39 01 00 00 00 00 02 05 00 39 01 00 00 00 00 02 06 00 39 01 00 00 00 00 02 07 81 39 01 00 00 00 00 02 08 81 39 01 00 00 00 00 02 09 81 39 01 00 00 00 00 02 0a 81 39 01 00 00 00 00 02 0b 81 39 01 00 00 00 00 02 0c 81 39 01 00 00 00 00 02 0d 81 39 01 00 00 00 00 02 0e 81 39 01 00 00 00 00 02 0f 81 39 01 00 00 00 00 02 10 81 39 01 00 00 00 00 02 11 81 39 01 00 00 00 00 02 12 81 39 01 00 00 00 00 02 13 81 39 01 00 00 00 00 02 14 81 39 01 00 00 00 00 02 15 82 39 01 00 00 00 00 02 16 82 39 01 00 00 00 00 02 17 82 39 01 00 00 00 00 02 18 82 39 01 00 00 00 00 02 19 82 39 01 00 00 00 00 02 1a 82 39 01 00 00 00 00 02 1b 82 39 01 00 00 00 00 02 1c 82 39 01 00 00 00 00 02 1d 82 39 01 00 00 00 00 02 1e 82 39 01 00 00 00 00 02 1f 82 39 01 00 00 00 00 02 20 82 39 01 00 00 00 00 02 21 82 39 01 00 00 00 00 02 22 83 39 01 00 00 00 00 02 23 83 39 01 00 00 00 00 02 24 83 39 01 00 00 00 00 02 25 83 39 01 00 00 00 00 02 26 83 39 01 00 00 00 00 02 27 83 39 01 00 00 00 00 02 28 83 39 01 00 00 00 00 02 29 83 39 01 00 00 00 00 02 2a 83 39 01 00 00 00 00 02 2b 83 39 01 00 00 00 00 02 2c 83 39 01 00 00 00 00 02 2d 83 39 01 00 00 00 00 02 2e 83 39 01 00 00 00 00 02 2f 83 39 01 00 00 00 00 02 30 84 39 01 00 00 00 00 02 31 84 39 01 00 00 00 00 02 32 84 39 01 00 00 00 00 02 33 84 39 01 00 00 00 00 02 34 84 39 01 00 00 00 00 02 35 84 39 01 00 00 00 00 02 36 84 39 01 00 00 00 00 02 37 84 39 01 00 00 00 00 02 38 84 39 01 00 00 00 00 02 39 84 39 01 00 00 00 00 02 3a 84 39 01 00 00 00 00 02 3b 84 39 01 00 00 00 00 02 3c 84 39 01 00 00 00 00 02 3d 85 39 01 00 00 00 00 02 3e 85 39 01 00 00 00 00 02 3f 85 39 01 00 00 00 00 02 40 85 39 01 00 00 00 00 02 41 85 39 01 00 00 00 00 02 42 85 39 01 00 00 00 00 02 43 85 39 01 00 00 00 00 02 44 85 39 01 00 00 00 00 02 45 85 39 01 00 00 00 00 02 46 85 39 01 00 00 00 00 02 47 85 39 01 00 00 00 00 02 48 85 39 01 00 00 00 00 02 49 85 39 01 00 00 00 00 02 4a 85 39 01 00 00 00 00 02 4b 86 39 01 00 00 00 00 02 4c 86 39 01 00 00 00 00 02 4d 86 39 01 00 00 00 00 02 4e 86 39 01 00 00 00 00 02 4f 86 39 01 00 00 00 00 02 50 86 39 01 00 00 00 00 02 51 86 39 01 00 00 00 00 02 52 86 39 01 00 00 00 00 02 53 86 39 01 00 00 00 00 02 54 86 39 01 00 00 00 00 02 55 86 39 01 00 00 00 00 02 56 86 39 01 00 00 00 00 02 57 86 39 01 00 00 00 00 02 58 87 39 01 00 00 00 00 02 59 87 39 01 00 00 00 00 02 5a 87 39 01 00 00 00 00 02 5b 87 39 01 00 00 00 00 02 5c 87 39 01 00 00 00 00 02 5d 87 39 01 00 00 00 00 02 5e 87 39 01 00 00 00 00 02 5f 87 39 01 00 00 00 00 02 60 87 39 01 00 00 00 00 02 61 87 39 01 00 00 00 00 02 62 87 39 01 00 00 00 00 02 63 87 39 01 00 00 00 00 02 64 87 39 01 00 00 00 00 02 65 87 39 01 00 00 00 00 02 66 88 39 01 00 00 00 00 02 67 88 39 01 00 00 00 00 02 68 88 39 01 00 00 00 00 02 69 88 39 01 00 00 00 00 02 6a 88 39 01 00 00 00 00 02 6b 88 39 01 00 00 00 00 02 6c 88 39 01 00 00 00 00 02 6d 88 39 01 00 00 00 00 02 6e 88 39 01 00 00 00 00 02 6f 88 39 01 00 00 00 00 02 70 88 39 01 00 00 00 00 02 71 88 39 01 00 00 00 00 02 72 88 39 01 00 00 00 00 02 73 89 39 01 00 00 00 00 02 74 89 39 01 00 00 00 00 02 75 89 39 01 00 00 00 00 02 76 89 39 01 00 00 00 00 02 77 89 39 01 00 00 00 00 02 78 89 39 01 00 00 00 00 02 79 89 39 01 00 00 00 00 02 7a 89 39 01 00 00 00 00 02 7b 89 39 01 00 00 00 00 02 7c 89 39 01 00 00 00 00 02 7d 89 39 01 00 00 00 00 02 7e 89 39 01 00 00 00 00 02 7f 89 39 01 00 00 00 00 04 ff 98 81 06 39 01 00 00 00 00 02 00 89 39 01 00 00 00 00 02 01 8a 39 01 00 00 00 00 02 02 8a 39 01 00 00 00 00 02 03 8a 39 01 00 00 00 00 02 04 8a 39 01 00 00 00 00 02 05 8a 39 01 00 00 00 00 02 06 8a 39 01 00 00 00 00 02 07 8a 39 01 00 00 00 00 02 08 8a 39 01 00 00 00 00 02 09 8a 39 01 00 00 00 00 02 0a 8a 39 01 00 00 00 00 02 0b 8a 39 01 00 00 00 00 02 0c 8a 39 01 00 00 00 00 02 0d 8a 39 01 00 00 00 00 02 0e 8b 39 01 00 00 00 00 02 0f 8b 39 01 00 00 00 00 02 10 8b 39 01 00 00 00 00 02 11 8b 39 01 00 00 00 00 02 12 8b 39 01 00 00 00 00 02 13 8b 39 01 00 00 00 00 02 14 8b 39 01 00 00 00 00 02 15 8b 39 01 00 00 00 00 02 16 8b 39 01 00 00 00 00 02 17 8b 39 01 00 00 00 00 02 18 8b 39 01 00 00 00 00 02 19 8b 39 01 00 00 00 00 02 1a 8b 39 01 00 00 00 00 02 1b 8c 39 01 00 00 00 00 02 1c 8c 39 01 00 00 00 00 02 1d 8c 39 01 00 00 00 00 02 1e 8c 39 01 00 00 00 00 02 1f 8c 39 01 00 00 00 00 02 20 8c 39 01 00 00 00 00 02 21 8c 39 01 00 00 00 00 02 22 8c 39 01 00 00 00 00 02 23 8c 39 01 00 00 00 00 02 24 8c 39 01 00 00 00 00 02 25 8c 39 01 00 00 00 00 02 26 8c 39 01 00 00 00 00 02 27 8c 39 01 00 00 00 00 02 28 8c 39 01 00 00 00 00 02 29 8d 39 01 00 00 00 00 02 2a 8d 39 01 00 00 00 00 02 2b 8d 39 01 00 00 00 00 02 2c 8d 39 01 00 00 00 00 02 2d 8d 39 01 00 00 00 00 02 2e 8d 39 01 00 00 00 00 02 2f 8d 39 01 00 00 00 00 02 30 8d 39 01 00 00 00 00 02 31 8d 39 01 00 00 00 00 02 32 8d 39 01 00 00 00 00 02 33 8d 39 01 00 00 00 00 02 34 8d 39 01 00 00 00 00 02 35 8d 39 01 00 00 00 00 02 36 8e 39 01 00 00 00 00 02 37 8e 39 01 00 00 00 00 02 38 8e 39 01 00 00 00 00 02 39 8e 39 01 00 00 00 00 02 3a 8e 39 01 00 00 00 00 02 3b 8e 39 01 00 00 00 00 02 3c 8e 39 01 00 00 00 00 02 3d 8e 39 01 00 00 00 00 02 3e 8e 39 01 00 00 00 00 02 3f 8e 39 01 00 00 00 00 02 40 8e 39 01 00 00 00 00 02 41 8e 39 01 00 00 00 00 02 42 8e 39 01 00 00 00 00 02 43 8e 39 01 00 00 00 00 02 44 8f 39 01 00 00 00 00 02 45 8f 39 01 00 00 00 00 02 46 8f 39 01 00 00 00 00 02 47 8f 39 01 00 00 00 00 02 48 8f 39 01 00 00 00 00 02 49 8f 39 01 00 00 00 00 02 4a 8f 39 01 00 00 00 00 02 4b 8f 39 01 00 00 00 00 02 4c 8f 39 01 00 00 00 00 02 4d 8f 39 01 00 00 00 00 02 4e 8f 39 01 00 00 00 00 02 4f 8f 39 01 00 00 00 00 02 50 8f 39 01 00 00 00 00 02 51 90 39 01 00 00 00 00 02 52 90 39 01 00 00 00 00 02 53 90 39 01 00 00 00 00 02 54 90 39 01 00 00 00 00 02 55 90 39 01 00 00 00 00 02 56 90 39 01 00 00 00 00 02 57 90 39 01 00 00 00 00 02 58 90 39 01 00 00 00 00 02 59 90 39 01 00 00 00 00 02 5a 90 39 01 00 00 00 00 02 5b 90 39 01 00 00 00 00 02 5c 90 39 01 00 00 00 00 02 5d 90 39 01 00 00 00 00 02 5e 90 39 01 00 00 00 00 02 5f 91 39 01 00 00 00 00 02 60 91 39 01 00 00 00 00 02 61 91 39 01 00 00 00 00 02 62 91 39 01 00 00 00 00 02 63 91 39 01 00 00 00 00 02 64 91 39 01 00 00 00 00 02 65 91 39 01 00 00 00 00 02 66 91 39 01 00 00 00 00 02 67 91 39 01 00 00 00 00 02 68 91 39 01 00 00 00 00 02 69 91 39 01 00 00 00 00 02 6a 91 39 01 00 00 00 00 02 6b 91 39 01 00 00 00 00 02 6c 92 39 01 00 00 00 00 02 6d 92 39 01 00 00 00 00 02 6e 92 39 01 00 00 00 00 02 6f 92 39 01 00 00 00 00 02 70 92 39 01 00 00 00 00 02 71 92 39 01 00 00 00 00 02 72 92 39 01 00 00 00 00 02 73 92 39 01 00 00 00 00 02 74 92 39 01 00 00 00 00 02 75 92 39 01 00 00 00 00 02 76 92 39 01 00 00 00 00 02 77 92 39 01 00 00 00 00 02 78 92 39 01 00 00 00 00 02 79 92 39 01 00 00 00 00 02 7a 93 39 01 00 00 00 00 02 7b 93 39 01 00 00 00 00 02 7c 93 39 01 00 00 00 00 02 7d 93 39 01 00 00 00 00 02 7e 93 39 01 00 00 00 00 02 7f 93 39 01 00 00 00 00 04 ff 98 81 07 39 01 00 00 00 00 02 00 00 39 01 00 00 00 00 02 01 00 39 01 00 00 00 00 02 02 00 39 01 00 00 00 00 02 03 00 39 01 00 00 00 00 02 04 00 39 01 00 00 00 00 02 05 00 39 01 00 00 00 00 02 06 00 39 01 00 00 00 00 02 07 81 39 01 00 00 00 00 02 08 81 39 01 00 00 00 00 02 09 81 39 01 00 00 00 00 02 0a 81 39 01 00 00 00 00 02 0b 81 39 01 00 00 00 00 02 0c 81 39 01 00 00 00 00 02 0d 81 39 01 00 00 00 00 02 0e 81 39 01 00 00 00 00 02 0f 81 39 01 00 00 00 00 02 10 81 39 01 00 00 00 00 02 11 81 39 01 00 00 00 00 02 12 81 39 01 00 00 00 00 02 13 81 39 01 00 00 00 00 02 14 81 39 01 00 00 00 00 02 15 82 39 01 00 00 00 00 02 16 82 39 01 00 00 00 00 02 17 82 39 01 00 00 00 00 02 18 82 39 01 00 00 00 00 02 19 82 39 01 00 00 00 00 02 1a 82 39 01 00 00 00 00 02 1b 82 39 01 00 00 00 00 02 1c 82 39 01 00 00 00 00 02 1d 82 39 01 00 00 00 00 02 1e 82 39 01 00 00 00 00 02 1f 82 39 01 00 00 00 00 02 20 82 39 01 00 00 00 00 02 21 82 39 01 00 00 00 00 02 22 83 39 01 00 00 00 00 02 23 83 39 01 00 00 00 00 02 24 83 39 01 00 00 00 00 02 25 83 39 01 00 00 00 00 02 26 83 39 01 00 00 00 00 02 27 83 39 01 00 00 00 00 02 28 83 39 01 00 00 00 00 02 29 83 39 01 00 00 00 00 02 2a 83 39 01 00 00 00 00 02 2b 83 39 01 00 00 00 00 02 2c 83 39 01 00 00 00 00 02 2d 83 39 01 00 00 00 00 02 2e 83 39 01 00 00 00 00 02 2f 83 39 01 00 00 00 00 02 30 84 39 01 00 00 00 00 02 31 84 39 01 00 00 00 00 02 32 84 39 01 00 00 00 00 02 33 84 39 01 00 00 00 00 02 34 84 39 01 00 00 00 00 02 35 84 39 01 00 00 00 00 02 36 84 39 01 00 00 00 00 02 37 84 39 01 00 00 00 00 02 38 84 39 01 00 00 00 00 02 39 84 39 01 00 00 00 00 02 3a 84 39 01 00 00 00 00 02 3b 84 39 01 00 00 00 00 02 3c 84 39 01 00 00 00 00 02 3d 85 39 01 00 00 00 00 02 3e 85 39 01 00 00 00 00 02 3f 85 39 01 00 00 00 00 02 40 85 39 01 00 00 00 00 02 41 85 39 01 00 00 00 00 02 42 85 39 01 00 00 00 00 02 43 85 39 01 00 00 00 00 02 44 85 39 01 00 00 00 00 02 45 85 39 01 00 00 00 00 02 46 85 39 01 00 00 00 00 02 47 85 39 01 00 00 00 00 02 48 85 39 01 00 00 00 00 02 49 85 39 01 00 00 00 00 02 4a 85 39 01 00 00 00 00 02 4b 86 39 01 00 00 00 00 02 4c 86 39 01 00 00 00 00 02 4d 86 39 01 00 00 00 00 02 4e 86 39 01 00 00 00 00 02 4f 86 39 01 00 00 00 00 02 50 86 39 01 00 00 00 00 02 51 86 39 01 00 00 00 00 02 52 86 39 01 00 00 00 00 02 53 86 39 01 00 00 00 00 02 54 86 39 01 00 00 00 00 02 55 86 39 01 00 00 00 00 02 56 86 39 01 00 00 00 00 02 57 86 39 01 00 00 00 00 02 58 87 39 01 00 00 00 00 02 59 87 39 01 00 00 00 00 02 5a 87 39 01 00 00 00 00 02 5b 87 39 01 00 00 00 00 02 5c 87 39 01 00 00 00 00 02 5d 87 39 01 00 00 00 00 02 5e 87 39 01 00 00 00 00 02 5f 87 39 01 00 00 00 00 02 60 87 39 01 00 00 00 00 02 61 87 39 01 00 00 00 00 02 62 87 39 01 00 00 00 00 02 63 87 39 01 00 00 00 00 02 64 87 39 01 00 00 00 00 02 65 87 39 01 00 00 00 00 02 66 88 39 01 00 00 00 00 02 67 88 39 01 00 00 00 00 02 68 88 39 01 00 00 00 00 02 69 88 39 01 00 00 00 00 02 6a 88 39 01 00 00 00 00 02 6b 88 39 01 00 00 00 00 02 6c 88 39 01 00 00 00 00 02 6d 88 39 01 00 00 00 00 02 6e 88 39 01 00 00 00 00 02 6f 88 39 01 00 00 00 00 02 70 88 39 01 00 00 00 00 02 71 88 39 01 00 00 00 00 02 72 88 39 01 00 00 00 00 02 73 89 39 01 00 00 00 00 02 74 89 39 01 00 00 00 00 02 75 89 39 01 00 00 00 00 02 76 89 39 01 00 00 00 00 02 77 89 39 01 00 00 00 00 02 78 89 39 01 00 00 00 00 02 79 89 39 01 00 00 00 00 02 7a 89 39 01 00 00 00 00 02 7b 89 39 01 00 00 00 00 02 7c 89 39 01 00 00 00 00 02 7d 89 39 01 00 00 00 00 02 7e 89 39 01 00 00 00 00 02 7f 89 39 01 00 00 00 00 04 ff 98 81 08 39 01 00 00 00 00 02 00 89 39 01 00 00 00 00 02 01 8a 39 01 00 00 00 00 02 02 8a 39 01 00 00 00 00 02 03 8a 39 01 00 00 00 00 02 04 8a 39 01 00 00 00 00 02 05 8a 39 01 00 00 00 00 02 06 8a 39 01 00 00 00 00 02 07 8a 39 01 00 00 00 00 02 08 8a 39 01 00 00 00 00 02 09 8a 39 01 00 00 00 00 02 0a 8a 39 01 00 00 00 00 02 0b 8a 39 01 00 00 00 00 02 0c 8a 39 01 00 00 00 00 02 0d 8a 39 01 00 00 00 00 02 0e 8b 39 01 00 00 00 00 02 0f 8b 39 01 00 00 00 00 02 10 8b 39 01 00 00 00 00 02 11 8b 39 01 00 00 00 00 02 12 8b 39 01 00 00 00 00 02 13 8b 39 01 00 00 00 00 02 14 8b 39 01 00 00 00 00 02 15 8b 39 01 00 00 00 00 02 16 8b 39 01 00 00 00 00 02 17 8b 39 01 00 00 00 00 02 18 8b 39 01 00 00 00 00 02 19 8b 39 01 00 00 00 00 02 1a 8b 39 01 00 00 00 00 02 1b 8c 39 01 00 00 00 00 02 1c 8c 39 01 00 00 00 00 02 1d 8c 39 01 00 00 00 00 02 1e 8c 39 01 00 00 00 00 02 1f 8c 39 01 00 00 00 00 02 20 8c 39 01 00 00 00 00 02 21 8c 39 01 00 00 00 00 02 22 8c 39 01 00 00 00 00 02 23 8c 39 01 00 00 00 00 02 24 8c 39 01 00 00 00 00 02 25 8c 39 01 00 00 00 00 02 26 8c 39 01 00 00 00 00 02 27 8c 39 01 00 00 00 00 02 28 8c 39 01 00 00 00 00 02 29 8d 39 01 00 00 00 00 02 2a 8d 39 01 00 00 00 00 02 2b 8d 39 01 00 00 00 00 02 2c 8d 39 01 00 00 00 00 02 2d 8d 39 01 00 00 00 00 02 2e 8d 39 01 00 00 00 00 02 2f 8d 39 01 00 00 00 00 02 30 8d 39 01 00 00 00 00 02 31 8d 39 01 00 00 00 00 02 32 8d 39 01 00 00 00 00 02 33 8d 39 01 00 00 00 00 02 34 8d 39 01 00 00 00 00 02 35 8d 39 01 00 00 00 00 02 36 8e 39 01 00 00 00 00 02 37 8e 39 01 00 00 00 00 02 38 8e 39 01 00 00 00 00 02 39 8e 39 01 00 00 00 00 02 3a 8e 39 01 00 00 00 00 02 3b 8e 39 01 00 00 00 00 02 3c 8e 39 01 00 00 00 00 02 3d 8e 39 01 00 00 00 00 02 3e 8e 39 01 00 00 00 00 02 3f 8e 39 01 00 00 00 00 02 40 8e 39 01 00 00 00 00 02 41 8e 39 01 00 00 00 00 02 42 8e 39 01 00 00 00 00 02 43 8e 39 01 00 00 00 00 02 44 8f 39 01 00 00 00 00 02 45 8f 39 01 00 00 00 00 02 46 8f 39 01 00 00 00 00 02 47 8f 39 01 00 00 00 00 02 48 8f 39 01 00 00 00 00 02 49 8f 39 01 00 00 00 00 02 4a 8f 39 01 00 00 00 00 02 4b 8f 39 01 00 00 00 00 02 4c 8f 39 01 00 00 00 00 02 4d 8f 39 01 00 00 00 00 02 4e 8f 39 01 00 00 00 00 02 4f 8f 39 01 00 00 00 00 02 50 8f 39 01 00 00 00 00 02 51 90 39 01 00 00 00 00 02 52 90 39 01 00 00 00 00 02 53 90 39 01 00 00 00 00 02 54 90 39 01 00 00 00 00 02 55 90 39 01 00 00 00 00 02 56 90 39 01 00 00 00 00 02 57 90 39 01 00 00 00 00 02 58 90 39 01 00 00 00 00 02 59 90 39 01 00 00 00 00 02 5a 90 39 01 00 00 00 00 02 5b 90 39 01 00 00 00 00 02 5c 90 39 01 00 00 00 00 02 5d 90 39 01 00 00 00 00 02 5e 90 39 01 00 00 00 00 02 5f 91 39 01 00 00 00 00 02 60 91 39 01 00 00 00 00 02 61 91 39 01 00 00 00 00 02 62 91 39 01 00 00 00 00 02 63 91 39 01 00 00 00 00 02 64 91 39 01 00 00 00 00 02 65 91 39 01 00 00 00 00 02 66 91 39 01 00 00 00 00 02 67 91 39 01 00 00 00 00 02 68 91 39 01 00 00 00 00 02 69 91 39 01 00 00 00 00 02 6a 91 39 01 00 00 00 00 02 6b 91 39 01 00 00 00 00 02 6c 92 39 01 00 00 00 00 02 6d 92 39 01 00 00 00 00 02 6e 92 39 01 00 00 00 00 02 6f 92 39 01 00 00 00 00 02 70 92 39 01 00 00 00 00 02 71 92 39 01 00 00 00 00 02 72 92 39 01 00 00 00 00 02 73 92 39 01 00 00 00 00 02 74 92 39 01 00 00 00 00 02 75 92 39 01 00 00 00 00 02 76 92 39 01 00 00 00 00 02 77 92 39 01 00 00 00 00 02 78 92 39 01 00 00 00 00 02 79 92 39 01 00 00 00 00 02 7a 93 39 01 00 00 00 00 02 7b 93 39 01 00 00 00 00 02 7c 93 39 01 00 00 00 00 02 7d 93 39 01 00 00 00 00 02 7e 93 39 01 00 00 00 00 02 7f 93 39 01 00 00 00 00 04 ff 98 81 09 39 01 00 00 00 00 02 00 00 39 01 00 00 00 00 02 01 00 39 01 00 00 00 00 02 02 00 39 01 00 00 00 00 02 03 00 39 01 00 00 00 00 02 04 00 39 01 00 00 00 00 02 05 00 39 01 00 00 00 00 02 06 00 39 01 00 00 00 00 02 07 00 39 01 00 00 00 00 02 08 00 39 01 00 00 00 00 02 09 00 39 01 00 00 00 00 02 0a 00 39 01 00 00 00 00 02 0b 00 39 01 00 00 00 00 02 0c 00 39 01 00 00 00 00 02 0d 00 39 01 00 00 00 00 02 0e 00 39 01 00 00 00 00 02 0f 00 39 01 00 00 00 00 02 10 00 39 01 00 00 00 00 02 11 00 39 01 00 00 00 00 02 12 00 39 01 00 00 00 00 02 13 00 39 01 00 00 00 00 02 14 00 39 01 00 00 00 00 02 15 00 39 01 00 00 00 00 02 16 00 39 01 00 00 00 00 02 17 00 39 01 00 00 00 00 02 18 00 39 01 00 00 00 00 02 19 00 39 01 00 00 00 00 02 1a 00 39 01 00 00 00 00 02 1b 00 39 01 00 00 00 00 02 1c 00 39 01 00 00 00 00 02 1d 00 39 01 00 00 00 00 02 1e 00 39 01 00 00 00 00 02 1f 00 39 01 00 00 00 00 02 20 00 39 01 00 00 00 00 02 21 00 39 01 00 00 00 00 02 22 00 39 01 00 00 00 00 02 23 00 39 01 00 00 00 00 02 24 00 39 01 00 00 00 00 02 25 00 39 01 00 00 00 00 02 26 00 39 01 00 00 00 00 02 27 00 39 01 00 00 00 00 02 28 00 39 01 00 00 00 00 02 29 00 39 01 00 00 00 00 02 2a 00 39 01 00 00 00 00 02 2b 00 39 01 00 00 00 00 02 2c 00 39 01 00 00 00 00 02 2d 00 39 01 00 00 00 00 02 2e 00 39 01 00 00 00 00 02 2f 00 39 01 00 00 00 00 02 30 00 39 01 00 00 00 00 02 31 00 39 01 00 00 00 00 02 32 00 39 01 00 00 00 00 02 33 00 39 01 00 00 00 00 02 34 00 39 01 00 00 00 00 02 35 00 39 01 00 00 00 00 02 36 00 39 01 00 00 00 00 02 37 00 39 01 00 00 00 00 02 38 00 39 01 00 00 00 00 02 39 00 39 01 00 00 00 00 02 3a 00 39 01 00 00 00 00 02 3b 00 39 01 00 00 00 00 02 3c 00 39 01 00 00 00 00 02 3d 00 39 01 00 00 00 00 02 3e 00 39 01 00 00 00 00 02 3f 00 39 01 00 00 00 00 02 40 00 39 01 00 00 00 00 02 41 00 39 01 00 00 00 00 02 42 00 39 01 00 00 00 00 02 43 00 39 01 00 00 00 00 02 44 00 39 01 00 00 00 00 02 45 00 39 01 00 00 00 00 02 46 00 39 01 00 00 00 00 02 47 00 39 01 00 00 00 00 02 48 00 39 01 00 00 00 00 02 49 00 39 01 00 00 00 00 02 4a 00 39 01 00 00 00 00 02 4b 00 39 01 00 00 00 00 02 4c 00 39 01 00 00 00 00 02 4d 00 39 01 00 00 00 00 02 4e 00 39 01 00 00 00 00 02 4f 00 39 01 00 00 00 00 02 50 00 39 01 00 00 00 00 02 51 00 39 01 00 00 00 00 02 52 00 39 01 00 00 00 00 02 53 00 39 01 00 00 00 00 02 54 00 39 01 00 00 00 00 02 55 00 39 01 00 00 00 00 02 56 00 39 01 00 00 00 00 02 57 00 39 01 00 00 00 00 02 58 00 39 01 00 00 00 00 02 59 00 39 01 00 00 00 00 02 5a 00 39 01 00 00 00 00 02 5b 00 39 01 00 00 00 00 02 5c 00 39 01 00 00 00 00 02 5d 00 39 01 00 00 00 00 02 5e 00 39 01 00 00 00 00 02 5f 00 39 01 00 00 00 00 02 60 00 39 01 00 00 00 00 02 61 00 39 01 00 00 00 00 02 62 00 39 01 00 00 00 00 02 63 00 39 01 00 00 00 00 02 64 00 39 01 00 00 00 00 02 65 00 39 01 00 00 00 00 02 66 00 39 01 00 00 00 00 02 67 00 39 01 00 00 00 00 02 68 00 39 01 00 00 00 00 02 69 00 39 01 00 00 00 00 02 6a 00 39 01 00 00 00 00 02 6b 00 39 01 00 00 00 00 02 6c 00 39 01 00 00 00 00 02 6d 00 39 01 00 00 00 00 02 6e 00 39 01 00 00 00 00 02 6f 00 39 01 00 00 00 00 02 70 00 39 01 00 00 00 00 02 71 00 39 01 00 00 00 00 02 72 00 39 01 00 00 00 00 02 73 00 39 01 00 00 00 00 02 74 00 39 01 00 00 00 00 02 75 00 39 01 00 00 00 00 02 76 00 39 01 00 00 00 00 02 77 00 39 01 00 00 00 00 02 78 00 39 01 00 00 00 00 02 79 00 39 01 00 00 00 00 02 7a 00 39 01 00 00 00 00 02 7b 00 39 01 00 00 00 00 02 7c 00 39 01 00 00 00 00 02 7d 00 39 01 00 00 00 00 02 7e 00 39 01 00 00 00 00 02 7f 00 39 01 00 00 00 00 04 ff 98 81 0a 39 01 00 00 00 00 02 00 00 39 01 00 00 00 00 02 01 81 39 01 00 00 00 00 02 02 81 39 01 00 00 00 00 02 03 81 39 01 00 00 00 00 02 04 81 39 01 00 00 00 00 02 05 81 39 01 00 00 00 00 02 06 81 39 01 00 00 00 00 02 07 81 39 01 00 00 00 00 02 08 81 39 01 00 00 00 00 02 09 81 39 01 00 00 00 00 02 0a 81 39 01 00 00 00 00 02 0b 81 39 01 00 00 00 00 02 0c 81 39 01 00 00 00 00 02 0d 81 39 01 00 00 00 00 02 0e 81 39 01 00 00 00 00 02 0f 81 39 01 00 00 00 00 02 10 81 39 01 00 00 00 00 02 11 81 39 01 00 00 00 00 02 12 81 39 01 00 00 00 00 02 13 81 39 01 00 00 00 00 02 14 81 39 01 00 00 00 00 02 15 81 39 01 00 00 00 00 02 16 81 39 01 00 00 00 00 02 17 81 39 01 00 00 00 00 02 18 81 39 01 00 00 00 00 02 19 81 39 01 00 00 00 00 02 1a 81 39 01 00 00 00 00 02 1b 81 39 01 00 00 00 00 02 1c 81 39 01 00 00 00 00 02 1d 81 39 01 00 00 00 00 02 1e 81 39 01 00 00 00 00 02 1f 81 39 01 00 00 00 00 02 20 81 39 01 00 00 00 00 02 21 81 39 01 00 00 00 00 02 22 81 39 01 00 00 00 00 02 23 81 39 01 00 00 00 00 02 24 81 39 01 00 00 00 00 02 25 81 39 01 00 00 00 00 02 26 81 39 01 00 00 00 00 02 27 81 39 01 00 00 00 00 02 28 81 39 01 00 00 00 00 02 29 81 39 01 00 00 00 00 02 2a 81 39 01 00 00 00 00 02 2b 81 39 01 00 00 00 00 02 2c 81 39 01 00 00 00 00 02 2d 81 39 01 00 00 00 00 02 2e 81 39 01 00 00 00 00 02 2f 81 39 01 00 00 00 00 02 30 81 39 01 00 00 00 00 02 31 81 39 01 00 00 00 00 02 32 81 39 01 00 00 00 00 02 33 81 39 01 00 00 00 00 02 34 81 39 01 00 00 00 00 02 35 81 39 01 00 00 00 00 02 36 81 39 01 00 00 00 00 02 37 81 39 01 00 00 00 00 02 38 81 39 01 00 00 00 00 02 39 81 39 01 00 00 00 00 02 3a 81 39 01 00 00 00 00 02 3b 81 39 01 00 00 00 00 02 3c 81 39 01 00 00 00 00 02 3d 81 39 01 00 00 00 00 02 3e 81 39 01 00 00 00 00 02 3f 81 39 01 00 00 00 00 02 40 81 39 01 00 00 00 00 02 41 81 39 01 00 00 00 00 02 42 81 39 01 00 00 00 00 02 43 81 39 01 00 00 00 00 02 44 81 39 01 00 00 00 00 02 45 81 39 01 00 00 00 00 02 46 81 39 01 00 00 00 00 02 47 81 39 01 00 00 00 00 02 48 81 39 01 00 00 00 00 02 49 81 39 01 00 00 00 00 02 4a 81 39 01 00 00 00 00 02 4b 81 39 01 00 00 00 00 02 4c 81 39 01 00 00 00 00 02 4d 81 39 01 00 00 00 00 02 4e 81 39 01 00 00 00 00 02 4f 81 39 01 00 00 00 00 02 50 81 39 01 00 00 00 00 02 51 81 39 01 00 00 00 00 02 52 81 39 01 00 00 00 00 02 53 81 39 01 00 00 00 00 02 54 81 39 01 00 00 00 00 02 55 81 39 01 00 00 00 00 02 56 81 39 01 00 00 00 00 02 57 81 39 01 00 00 00 00 02 58 81 39 01 00 00 00 00 02 59 81 39 01 00 00 00 00 02 5a 81 39 01 00 00 00 00 02 5b 81 39 01 00 00 00 00 02 5c 81 39 01 00 00 00 00 02 5d 81 39 01 00 00 00 00 02 5e 81 39 01 00 00 00 00 02 5f 81 39 01 00 00 00 00 02 60 81 39 01 00 00 00 00 02 61 81 39 01 00 00 00 00 02 62 81 39 01 00 00 00 00 02 63 81 39 01 00 00 00 00 02 64 81 39 01 00 00 00 00 02 65 81 39 01 00 00 00 00 02 66 81 39 01 00 00 00 00 02 67 81 39 01 00 00 00 00 02 68 81 39 01 00 00 00 00 02 69 81 39 01 00 00 00 00 02 6a 81 39 01 00 00 00 00 02 6b 81 39 01 00 00 00 00 02 6c 81 39 01 00 00 00 00 02 6d 81 39 01 00 00 00 00 02 6e 81 39 01 00 00 00 00 02 6f 81 39 01 00 00 00 00 02 70 81 39 01 00 00 00 00 02 71 81 39 01 00 00 00 00 02 72 81 39 01 00 00 00 00 02 73 81 39 01 00 00 00 00 02 74 81 39 01 00 00 00 00 02 75 81 39 01 00 00 00 00 02 76 81 39 01 00 00 00 00 02 77 81 39 01 00 00 00 00 02 78 81 39 01 00 00 00 00 02 79 81 39 01 00 00 00 00 02 7a 81 39 01 00 00 00 00 02 7b 81 39 01 00 00 00 00 02 7c 81 39 01 00 00 00 00 02 7d 81 39 01 00 00 00 00 02 7e 81 39 01 00 00 00 00 02 7f 81 39 01 00 00 00 00 04 ff 98 81 01 39 01 00 00 00 00 02 f3 01 39 01 00 00 00 00 04 ff 98 81 02 39 01 00 00 00 00 02 06 20 39 01 00 00 00 00 02 07 00 39 01 00 00 00 00 04 ff 98 81 00 39 01 00 00 00 00 03 51 0f ff 39 01 00 00 00 00 02 53 2c 39 01 00 00 00 00 02 55 80 39 01 00 00 00 00 02 35 00 05 01 00 00 78 00 02 11 00 05 01 00 00 14 00 02 29 00];
				qcom,mdss-dsi-off-command = [39 01 00 00 32 00 04 ff 98 81 0b 05 01 00 00 32 00 02 28 00 05 01 00 00 78 00 02 10 00];
				qcom,mdss-dsi-on-command-state = "dsi_lp_mode";
				qcom,mdss-dsi-off-command-state = "dsi_hs_mode";
				qcom,mdss-dsi-panel-status-command = [06 01 00 01 05 00 02 0a 08];
				qcom,mdss-dsi-panel-cabc-command = [06 01 00 01 05 00 02 f3 08];
				qcom,mdss-dsi-cabc-off-command = <0x39010000 0x4ff 0x98810105 0x1000078 0x2f301 0x39010000 0x4ff 0x98810005 0x1000078 0x22900>;
				qcom,mdss-dsi-cabc-ui-command = <0x39010000 0x4ff 0x98810105 0x1000078 0x2f301 0x39010000 0x4ff 0x98810005 0x1000078 0x22900>;
				qcom,mdss-dsi-cabc-still-image-command = <0x39010000 0x4ff 0x98810105 0x1000078 0x2f301 0x39010000 0x4ff 0x98810005 0x1000078 0x22900>;
				qcom,mdss-dsi-cabc-video-command = <0x39010000 0x4ff 0x98810105 0x1000078 0x2f301 0x39010000 0x4ff 0x98810005 0x1000078 0x22900>;
				qcom,mdss-dsi-panel-status-command-state = "dsi_lp_mode";
				qcom,mdss-dsi-panel-status-check-mode = "reg_read";
				qcom,mdss-dsi-panel-status-value = <0x9c>;
				qcom,mdss-dsi-tx-eot-append;
				qcom,mdss-dsi-h-sync-pulse = <1>;
				qcom,mdss-dsi-lp11-init;
				qcom,mdss-dsi-init-delay-us = <50000>;
				qcom,mdss-dsi-traffic-mode = "burst_mode";
				qcom,mdss-dsi-lane-map = "lane_map_0123";
				qcom,mdss-dsi-bllp-eof-power-mode;
				qcom,mdss-dsi-bllp-power-mode;
				qcom,mdss-dsi-hfp-power-mode;
				qcom,mdss-dsi-hbp-power-mode;
				qcom,mdss-dsi-hsa-power-mode;
				qcom,mdss-dsi-lane-0-state;
				qcom,mdss-dsi-lane-1-state;
				qcom,mdss-dsi-lane-2-state;
				qcom,mdss-dsi-panel-timings = <0xbc2a1c00 0x5458202e 0x20030400>;
				qcom,mdss-dsi-t-clk-post = <0x4>;
				qcom,mdss-dsi-t-clk-pre = <0x24>;
				qcom,mdss-dsi-bl-min-level = <1>;
				qcom,mdss-dsi-bl-max-level = <255>;
				qcom,mdss-dsi-dma-trigger = "trigger_sw";
				qcom,mdss-dsi-mdp-trigger = <0x0>;
				qcom,mdss-dsi-bl-pmic-control-type = "bl_ctrl_wled";
				qcom,mdss-dsi-reset-sequence = <1 10>, <0 1>, <1 15>;
				qcom,mdss-pan-physical-width-dimension = <62>;
				qcom,mdss-pan-physical-height-dimension = <110>;
				qcom,cont-splash-enabled;
				qcom,esd-check-enabled;
			};
};

