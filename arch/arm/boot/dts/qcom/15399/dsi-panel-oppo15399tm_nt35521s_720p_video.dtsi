/* Copyright (c) 2020, The Linux Foundation. All rights reserved.
*  Copyright (c) 2020, the_shahnawaz_sheikh (sheikhshahnawaz41299).
*
* This program is free software; you can redistribute it and/or modify
* it under the terms of the GNU General Public License version 2 and
* only version 2 as published by the Free Software Foundation.
*
* This program is distributed in the hope that it will be useful,
* but WITHOUT ANY WARRANTY; without even the implied warranty of
* MERCHANTABILITY or FITNESS FOR A PARTICULAR PURPOSE.  See the
* GNU General Public License for more details.
*/

&mdss_mdp {
		dsi_oppo15399tm_nt35521s_720p_video:	qcom,mdss_dsi_oppo15399tm_nt35521s_720p_video {
				qcom,mdss-dsi-panel-name = "oppo15399tm nt35521s 720p video mode dsi panel";
				qcom,mdss-dsi-panel-manufacture = "TM_0420";
				qcom,mdss-dsi-panel-version = "NT35521S";
				qcom,mdss-dsi-panel-controller = <&mdss_dsi0>;
				qcom,mdss-dsi-panel-type = "dsi_video_mode";
				qcom,mdss-dsi-panel-destination = "display_1";
				qcom,mdss-dsi-panel-framerate = <60>;
				qcom,mdss-dsi-virtual-channel-id = <0>;
				qcom,mdss-dsi-stream = <0>;
				qcom,mdss-dsi-panel-width = <720>;
				qcom,mdss-dsi-panel-height = <1280>;
				qcom,mdss-dsi-h-front-porch = <240>;
				qcom,mdss-dsi-h-back-porch = <230>;
				qcom,mdss-dsi-h-pulse-width = <8>;
				qcom,mdss-dsi-h-sync-skew = <0>;
				qcom,mdss-dsi-v-back-porch = <26>;
				qcom,mdss-dsi-v-front-porch = <26>;
				qcom,mdss-dsi-v-pulse-width = <8>;
				qcom,mdss-dsi-h-left-border = <0>;
				qcom,mdss-dsi-h-right-border = <0>;
				qcom,mdss-dsi-v-top-border = <0>;
				qcom,mdss-dsi-v-bottom-border = <0>;
				qcom,mdss-dsi-bpp = <24>;
				qcom,mdss-dsi-color-order = "rgb_swap_rgb";
				qcom,mdss-dsi-underflow-color = <255>;
				qcom,mdss-dsi-border-color = <0>;
				qcom,mdss-dsi-pixel-packing = "tight";
				qcom,mdss-dsi-on-command = [39 01 00 00 00 00 05 ff aa 55 25 01 39 01 00 00 00 00 02 6f 16 39 01 00 00 00 00 02 f7 10 39 01 00 00 00 00 05 ff aa 55 25 00 39 01 00 00 00 00 06 f0 55 aa 52 08 00 39 01 00 00 00 00 02 6f 02 39 01 00 00 00 00 02 b8 01 39 01 00 00 00 00 02 ec 05 39 01 00 00 00 00 03 bb aa aa 39 01 00 00 00 00 03 bc 00 00 39 01 00 00 00 00 02 c8 80 39 01 00 00 00 00 02 b6 06 39 01 00 00 00 00 06 f0 55 aa 52 08 01 39 01 00 00 00 00 03 b0 0f 0f 39 01 00 00 00 00 03 b1 0f 0f 39 01 00 00 00 00 03 bc 78 00 39 01 00 00 00 00 03 bd 78 00 39 01 00 00 00 00 02 ca 00 39 01 00 00 00 00 02 c0 04 39 01 00 00 00 00 03 b5 03 03 39 01 00 00 00 00 03 b3 1e 1e 39 01 00 00 00 00 03 b4 0f 0f 39 01 00 00 00 00 03 b9 34 34 39 01 00 00 00 00 03 ba 15 15 39 01 00 00 00 00 06 f0 55 aa 52 08 02 39 01 00 00 00 00 02 ee 03 39 01 00 00 00 00 11 b0 00 00 00 16 00 3a 00 56 00 6d 00 94 00 b3 00 e6 39 01 00 00 00 00 11 b1 01 0f 01 4f 01 82 01 d5 02 1a 02 1c 02 5d 02 a2 39 01 00 00 00 00 11 b2 02 cb 03 00 03 22 03 50 03 6d 03 92 03 ab 03 c1 39 01 00 00 00 00 05 b3 03 d1 03 d3 39 01 00 00 00 00 11 b4 00 9f 00 a7 00 b5 00 c2 00 ce 00 e4 00 f9 01 22 39 01 00 00 00 00 11 b5 01 42 01 72 01 9d 01 e9 02 26 02 28 02 65 02 a8 39 01 00 00 00 00 11 b6 02 d0 03 03 03 26 03 50 03 6d 03 91 03 a8 03 bf 39 01 00 00 00 00 05 b7 03 d0 03 d3 39 01 00 00 00 00 11 b8 00 5c 00 66 00 78 00 88 00 97 00 b2 00 cb 00 fb 39 01 00 00 00 00 11 b9 01 20 01 57 01 87 01 db 02 1c 02 1e 02 5e 02 a4 39 01 00 00 00 00 11 ba 02 cd 03 01 03 26 03 5a 03 83 03 a9 03 b0 03 bf 39 01 00 00 00 00 05 bb 03 d1 03 d3 39 01 00 00 00 00 06 f0 55 aa 52 08 06 39 01 00 00 00 00 03 b0 08 34 39 01 00 00 00 00 03 b1 31 34 39 01 00 00 00 00 03 b2 34 2e 39 01 00 00 00 00 03 b3 2d 34 39 01 00 00 00 00 03 b4 00 02 39 01 00 00 00 00 03 b5 34 12 39 01 00 00 00 00 03 b6 10 34 39 01 00 00 00 00 03 b7 34 18 39 01 00 00 00 00 03 b8 16 34 39 01 00 00 00 00 03 b9 34 34 39 01 00 00 00 00 03 ba 34 34 39 01 00 00 00 00 03 bb 34 17 39 01 00 00 00 00 03 bc 19 34 39 01 00 00 00 00 03 bd 34 11 39 01 00 00 00 00 03 be 13 34 39 01 00 00 00 00 03 bf 03 01 39 01 00 00 00 00 03 c0 34 2d 39 01 00 00 00 00 03 c1 2e 34 39 01 00 00 00 00 03 c2 34 31 39 01 00 00 00 00 03 c3 34 09 39 01 00 00 00 00 03 e5 34 34 39 01 00 00 00 00 03 c4 09 34 39 01 00 00 00 00 03 c5 31 34 39 01 00 00 00 00 03 c6 34 2d 39 01 00 00 00 00 03 c7 2e 34 39 01 00 00 00 00 03 c8 03 01 39 01 00 00 00 00 03 c9 34 17 39 01 00 00 00 00 03 ca 19 34 39 01 00 00 00 00 03 cb 34 11 39 01 00 00 00 00 03 cc 13 34 39 01 00 00 00 00 03 cd 34 34 39 01 00 00 00 00 03 ce 34 34 39 01 00 00 00 00 03 cf 34 12 39 01 00 00 00 00 03 d0 10 34 39 01 00 00 00 00 03 d1 34 18 39 01 00 00 00 00 03 d2 16 34 39 01 00 00 00 00 03 d3 00 02 39 01 00 00 00 00 03 d4 34 2e 39 01 00 00 00 00 03 d5 2d 34 39 01 00 00 00 00 03 d6 34 31 39 01 00 00 00 00 03 d7 34 08 39 01 00 00 00 00 03 e6 34 34 39 01 00 00 00 00 06 d8 00 00 00 00 00 39 01 00 00 00 00 06 d9 00 00 00 00 00 39 01 00 00 00 00 02 e7 00 39 01 00 00 00 00 06 f0 55 aa 52 08 05 39 01 00 00 00 00 02 ed 30 39 01 00 00 00 00 06 f0 55 aa 52 08 03 39 01 00 00 00 00 03 b1 20 00 39 01 00 00 00 00 03 b0 20 00 39 01 00 00 00 00 06 f0 55 aa 52 08 05 39 01 00 00 00 00 02 e5 00 39 01 00 00 00 00 06 f0 55 aa 52 08 05 39 01 00 00 00 00 03 b0 17 06 39 01 00 00 00 00 02 b8 00 39 01 00 00 00 00 06 bd 03 03 01 00 03 39 01 00 00 00 00 03 b1 17 06 39 01 00 00 00 00 03 b9 00 03 39 01 00 00 00 00 03 b2 17 06 39 01 00 00 00 00 03 ba 00 00 39 01 00 00 00 00 03 b3 17 06 39 01 00 00 00 00 03 bb 00 00 39 01 00 00 00 00 03 b4 17 06 39 01 00 00 00 00 03 b5 17 06 39 01 00 00 00 00 03 b6 17 06 39 01 00 00 00 00 03 b7 17 06 39 01 00 00 00 00 03 bc 00 03 39 01 00 00 00 00 02 e5 06 39 01 00 00 00 00 02 e6 06 39 01 00 00 00 00 02 e7 06 39 01 00 00 00 00 02 e8 06 39 01 00 00 00 00 02 e9 06 39 01 00 00 00 00 02 ea 06 39 01 00 00 00 00 02 eb 06 39 01 00 00 00 00 02 ec 06 39 01 00 00 00 00 06 f0 55 aa 52 08 05 39 01 00 00 00 00 02 c0 0b 39 01 00 00 00 00 02 c1 09 39 01 00 00 00 00 02 c2 0b 39 01 00 00 00 00 02 c3 09 39 01 00 00 00 00 06 f0 55 aa 52 08 03 39 01 00 00 00 00 06 b2 05 00 00 00 00 39 01 00 00 00 00 06 b3 05 00 00 00 00 39 01 00 00 00 00 06 b4 05 00 00 00 00 39 01 00 00 00 00 06 b5 05 00 00 00 00 39 01 00 00 00 00 06 f0 55 aa 52 08 05 39 01 00 00 00 00 02 c4 0f 39 01 00 00 00 00 02 c5 0f 39 01 00 00 00 00 02 c6 0f 39 01 00 00 00 00 02 c7 0f 39 01 00 00 00 00 06 f0 55 aa 52 08 03 39 01 00 00 00 00 06 b6 05 00 00 00 00 39 01 00 00 00 00 06 b7 05 00 00 00 00 39 01 00 00 00 00 06 b8 05 00 00 00 00 39 01 00 00 00 00 06 b9 05 00 00 00 00 39 01 00 00 00 00 06 f0 55 aa 52 08 05 39 01 00 00 00 00 03 c8 07 20 39 01 00 00 00 00 03 c9 03 20 39 01 00 00 00 00 03 ca 07 00 39 01 00 00 00 00 03 cb 03 00 39 01 00 00 00 00 06 f0 55 aa 52 08 03 39 01 00 00 00 00 06 ba 53 00 00 00 00 39 01 00 00 00 00 06 bb 53 00 00 00 00 39 01 00 00 00 00 06 bc 53 00 00 00 00 39 01 00 00 00 00 06 bd 53 00 00 00 00 39 01 00 00 00 00 06 f0 55 aa 52 08 05 39 01 00 00 00 00 06 d1 00 05 00 07 10 39 01 00 00 00 00 06 d2 00 05 04 07 10 39 01 00 00 00 00 06 d3 00 00 0a 07 10 39 01 00 00 00 00 06 d4 00 00 0a 07 10 39 01 00 00 00 00 06 f0 55 aa 52 08 05 39 01 00 00 00 00 08 d0 00 00 00 00 00 00 00 39 01 00 00 00 00 0c d5 00 00 00 00 00 00 00 00 00 00 00 39 01 00 00 00 00 0c d6 00 00 00 00 00 00 00 00 00 00 00 39 01 00 00 00 00 0c d7 00 00 00 00 00 00 00 00 00 00 00 39 01 00 00 00 00 06 d8 00 00 00 00 00 39 01 00 00 00 00 06 f0 55 aa 52 08 03 39 01 00 00 00 00 02 c4 60 39 01 00 00 00 00 02 c5 40 39 01 00 00 00 00 02 c6 60 39 01 00 00 00 00 02 c7 40 39 01 00 00 00 00 02 6f 01 39 01 00 00 00 00 02 f9 46 39 01 00 00 00 00 06 f0 55 aa 52 08 04 39 01 00 00 00 00 02 c3 83 39 01 00 00 00 00 06 f0 55 aa 52 08 00 39 01 00 00 00 00 02 c8 80 39 01 00 00 00 00 04 d9 01 01 4d 39 01 00 00 00 00 02 51 ff 39 01 00 00 00 00 02 53 24 39 01 00 00 00 00 02 55 81 39 01 00 00 00 00 06 f0 55 aa 52 08 00 39 01 00 00 00 00 07 cc 40 36 87 00 00 00 39 01 00 00 00 00 0d ce 10 10 10 10 10 10 10 10 10 10 10 10 39 01 00 00 00 00 11 d1 00 02 03 04 06 08 0a 0c 0e 0e 0c 0a 08 04 02 00 05 01 00 00 78 00 02 11 00 05 01 00 00 14 00 02 29 00];
				qcom,mdss-dsi-off-command = [05 01 00 00 32 00 02 28 00 05 01 00 00 78 00 02 10 00];
				qcom,mdss-dsi-on-command-state = "dsi_lp_mode";
				qcom,mdss-dsi-off-command-state = "dsi_hs_mode";
				qcom,mdss-dsi-cabc-off-command = [15 01 00 00 10 00 02 55 00 05 01 00 00 10 00 02 29 00];
				qcom,mdss-dsi-cabc-ui-command = [15 01 00 00 10 00 02 55 01 05 01 00 00 10 00 02 29 00];
				qcom,mdss-dsi-cabc-still-image-command = [15 01 00 00 10 00 02 55 02 05 01 00 00 10 00 02 29 00];
				qcom,mdss-dsi-cabc-video-command = [15 01 00 00 10 00 02 55 03 05 01 00 00 10 00 02 29 00];
				qcom,mdss-dsi-panel-status-command = [06 01 00 01 05 00 02 0a 08];
				qcom,mdss-dsi-panel-status-command-state = "dsi_lp_mode";
				qcom,mdss-dsi-panel-status-check-mode = "reg_read";
				qcom,mdss-dsi-panel-status-value = <0x9c>;
				qcom,mdss-dsi-tx-eot-append;
				qcom,mdss-dsi-h-sync-pulse = <1>;
				qcom,mdss-dsi-lp11-init;
				qcom,mdss-dsi-init-delay-us = <50000>;
				qcom,mdss-dsi-traffic-mode = "burst_mode";
				qcom,mdss-dsi-lane-map = "lane_map_0123";
				qcom,mdss-dsi-bllp-eof-power-mode;
				qcom,mdss-dsi-bllp-power-mode;
				qcom,mdss-dsi-hfp-power-mode;
				qcom,mdss-dsi-hbp-power-mode;
				qcom,mdss-dsi-hsa-power-mode;
				qcom,mdss-dsi-lane-0-state;
				qcom,mdss-dsi-lane-1-state;
				qcom,mdss-dsi-lane-2-state;
				qcom,mdss-dsi-panel-timings = <0xe2302000 0x5c622434 0x26030400>;
				qcom,mdss-dsi-t-clk-post = <0x4>;
				qcom,mdss-dsi-t-clk-pre = <0x29>;
				qcom,mdss-dsi-bl-min-level = <16>;
				qcom,mdss-dsi-bl-max-level = <240>;
				qcom,mdss-dsi-dma-trigger = "trigger_sw";
				qcom,mdss-dsi-mdp-trigger = <0x0>;
				qcom,mdss-dsi-bl-pmic-control-type = "bl_ctrl_wled";
				qcom,mdss-dsi-reset-sequence = <1 10>, <0 1>, <1 15>;
				qcom,mdss-pan-physical-width-dimension = <62>;
				qcom,mdss-pan-physical-height-dimension = <110>;
				qcom,cont-splash-enabled;
				qcom,esd-check-enabled;
			};
};

