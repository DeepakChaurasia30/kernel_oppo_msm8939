/* Copyright (c) 2020, The Linux Foundation. All rights reserved.
*  Copyright (c) 2020, the_shahnawaz_sheikh (sheikhshahnawaz41299).
*
* This program is free software; you can redistribute it and/or modify
* it under the terms of the GNU General Public License version 2 and
* only version 2 as published by the Free Software Foundation.
*
* This program is distributed in the hope that it will be useful,
* but WITHOUT ANY WARRANTY; without even the implied warranty of
* MERCHANTABILITY or FITNESS FOR A PARTICULAR PURPOSE.  See the
* GNU General Public License for more details.
*/

//#include "../msm8916-audio-internal_codec.dtsi"

&soc {
	sound {
		compatible = "qcom,msm8x16-audio-codec";
		qcom,model = "msm8x16-snd-card-mtp";
		qcom,msm-snd-card-id = <0>;
		qcom,msm-codec-type = "internal";
		qcom,msm-ext-pa = "primary";
		qcom,msm-mclk-freq = <9600000>;
		/*zhangping@Multimedia, 2015-03-12, Modify for headset*/
		/*qcom,msm-mbhc-hphl-swh = <0>;*/
		qcom,msm-mbhc-hphl-swh = <1>;
        /*zhangping@Multimedia, 2015-03-12, Modify end*/
		qcom,msm-mbhc-gnd-swh = <0>;
		qcom,msm-micbias1-ext-cap;
        /*zhangping@Multimedia, 2015-03-11, Modify for headset*/
	        qcom,msm-micbias2-ext-cap;
        qcom,msm-hs-micbias-type = "internal";	
       /* qcom,msm-hs-micbias-type = "external";*/	
        /*zhangping@Multimedia, 2015-03-11, Modify end*/
		qcom,audio-routing =
			"RX_BIAS", "MCLK",
			"SPK_RX_BIAS", "MCLK",
			"INT_LDO_H", "MCLK",
			"MIC BIAS External", "Handset Mic",
			"MIC BIAS Internal2", "Headset Mic",
			"MIC BIAS External", "Secondary Mic",
			"AMIC1", "MIC BIAS External",
			"AMIC2", "MIC BIAS Internal2",
			"AMIC3", "MIC BIAS External",
			"DMIC1", "MIC BIAS Internal1",
			"MIC BIAS Internal1", "Digital Mic1",
			"DMIC2", "MIC BIAS Internal1",
			"MIC BIAS Internal1", "Digital Mic2";
		/delete-property/ qcom,cdc-us-euro-gpios;
		spk-pa-en = <&msm_gpio 120 0x00>;
		yda145_boost-en = <&msm_gpio 118 0x00>;
	pcb-ver-flag0 = <&msm_gpio 50 0x00>;
	pcb-ver-flag1 = <&msm_gpio 51 0x00>;
	pcb-ver-flag2 = <&msm_gpio 52 0x00>;
        /*the_shahnawaz_sheikh, Add end*/
	};
};

