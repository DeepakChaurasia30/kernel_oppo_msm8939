/* Copyright (c) 2020, The Linux Foundation. All rights reserved.
*  Copyright (c) 2020, the_shahnawaz_sheikh (sheikhshahnawaz41299).
*
* This program is free software; you can redistribute it and/or modify
* it under the terms of the GNU General Public License version 2 and
* only version 2 as published by the Free Software Foundation.
*
* This program is distributed in the hope that it will be useful,
* but WITHOUT ANY WARRANTY; without even the implied warranty of
* MERCHANTABILITY or FITNESS FOR A PARTICULAR PURPOSE.  See the
* GNU General Public License for more details.
*/

&mdss_mdp {
		dsi_oppo15399truly_nt35521s_720p_video:	qcom,mdss_dsi_oppo15399truly_nt35521s_720p_video {
				qcom,mdss-dsi-panel-name = "oppo15399truly nt35521s 720p video mode dsi panel";
				qcom,mdss-dsi-panel-manufacture = "TRULY";
				qcom,mdss-dsi-panel-version = "NT35521S";
				qcom,mdss-dsi-panel-controller = <&mdss_dsi0>;
				qcom,mdss-dsi-panel-type = "dsi_video_mode";
				qcom,mdss-dsi-panel-destination = "display_1";
				qcom,mdss-dsi-panel-framerate = <60>;
				qcom,mdss-dsi-virtual-channel-id = <0>;
				qcom,mdss-dsi-stream = <0>;
				qcom,mdss-dsi-panel-width = <720>;
				qcom,mdss-dsi-panel-height = <1280>;
				qcom,mdss-dsi-h-front-porch = <240>;
				qcom,mdss-dsi-h-back-porch = <230>;
				qcom,mdss-dsi-h-pulse-width = <8>;
				qcom,mdss-dsi-h-sync-skew = <0>;
				qcom,mdss-dsi-v-back-porch = <26>;
				qcom,mdss-dsi-v-front-porch = <26>;
				qcom,mdss-dsi-v-pulse-width = <8>;
				qcom,mdss-dsi-h-left-border = <0>;
				qcom,mdss-dsi-h-right-border = <0>;
				qcom,mdss-dsi-v-top-border = <0>;
				qcom,mdss-dsi-v-bottom-border = <0>;
				qcom,mdss-dsi-bpp = <24>;
				qcom,mdss-dsi-color-order = "rgb_swap_rgb";
				qcom,mdss-dsi-underflow-color = <0xff>;
				qcom,mdss-dsi-border-color = <0>;
				qcom,mdss-dsi-pixel-packing = "tight";
				qcom,mdss-dsi-on-command = <0x39010000 0x6f0 0x55aa5208 0x390100 0x3 0xb1682139 0x1000000 0x2b601 0x39010000 0x5b8 0x1020802 0x39010000 0x3bb 0x11113901 0x0 0x3bc0000 0x39010000 0x6f0 0x55aa5208 0x1390100 0x3 0xb00f0f39 0x1000000 0x3b10f 0xf390100 0x3 0xb3282839 0x1000000 0x3b419 0x19390100 0x3 0xb5050539 0x1000000 0x3b944 0x44390100 0x3 0xba242439 0x1000000 0x3bc88 0x390100 0x3 0xbd880039 0x1000000 0x2be44 0x39010000 0x2c0 0xc390100 0x2 0xca003901 0x0 0x6f055aa 0x52080239 0x1000000 0x2ee00 0x39010000 0x11b0 0x9500aa 0xc800e0 0xf50117 0x1310160 0x39010000 0x11b1 0x18401ba 0x1e40223 0x2520253 0x28502be 0x39010000 0x11b2 0x2de030e 0x32e0352 0x3700391 0x3a103b3 0x39010000 0x5b3 0x3c503d8 0x39010000 0x11b4 0x9500aa 0xc800e0 0xf50117 0x1310160 0x39010000 0x11b5 0x18401ba 0x1e40223 0x2520253 0x28502be 0x39010000 0x11b6 0x2de030e 0x32e0352 0x3700391 0x3a103b3 0x39010000 0x5b7 0x3c503d8 0x39010000 0x11b8 0x9500aa 0xc800e0 0xf50117 0x1310160 0x39010000 0x11b9 0x18401ba 0x1e40223 0x2520253 0x28502be 0x39010000 0x11ba 0x2de030e 0x32e0352 0x3700391 0x3a103b3 0x39010000 0x5bb 0x3c503d8 0x39010000 0x11bc 0x45005b 0x7a0094 0xaa00cf 0xeb011f 0x39010000 0x11bd 0x1480188 0x1bc020f 0x2510253 0x28502be 0x39010000 0x11be 0x2de030e 0x32e0352 0x3700391 0x3a103b3 0x39010000 0x5bf 0x3c503fc 0x39010000 0x11c0 0x45005b 0x7a0094 0xaa00cf 0xeb011f 0x39010000 0x11c1 0x1480188 0x1bc020f 0x2510253 0x28502be 0x39010000 0x11c2 0x2de030e 0x32e0352 0x3700391 0x3a103b3 0x39010000 0x5c3 0x3c503fc 0x39010000 0x11c4 0x45005b 0x7a0094 0xaa00cf 0xeb011f 0x39010000 0x11c5 0x1480188 0x1bc020f 0x2510253 0x28502be 0x39010000 0x11c6 0x2de030e 0x32e0352 0x3700391 0x3a103b3 0x39010000 0x5c7 0x3c503fc 0x39010000 0x6f0 0x55aa5208 0x3390100 0x3 0xb0200039 0x1000000 0x3b120 0x390100 0x6 0xb2040052 0x1513901 0x0 0x6b30400 0x52015139 0x1000000 0x6b604 0x520151 0x39010000 0x6b7 0x4005201 0x51390100 0x6 0xba440060 0x1723901 0x0 0x6bb4400 0x60017239 0x1000000 0x6bc53 0x30048 0x39010000 0x6bd 0x53000300 0x48390100 0x2 0xc4403901 0x0 0x2c54039 0x1000000 0x6f055 0xaa520805 0x39010000 0x3b0 0x17063901 0x0 0x2b80039 0x1000000 0x6bd0f 0x3030003 0x39010000 0x3b1 0x17063901 0x0 0x2b90039 0x1000000 0x3b217 0x6390100 0x2 0xba003901 0x0 0x3b31706 0x39010000 0x2bb 0x390100 0x3 0xb4170639 0x1000000 0x3b517 0x6390100 0x3 0xb6170639 0x1000000 0x3b717 0x6390100 0x2 0xbc003901 0x0 0x2e50639 0x1000000 0x2e606 0x39010000 0x2e7 0x6390100 0x2 0xe8063901 0x0 0x2e90a39 0x1000000 0x2ea06 0x39010000 0x2eb 0x6390100 0x2 0xec063901 0x0 0x2ed3039 0x1000000 0x2c007 0x39010000 0x2c1 0x5390100 0x2 0xc4823901 0x0 0x2c58039 0x1000000 0x3c803 0x20390100 0x3 0xc9012139 0x1000000 0x3ca03 0x20390100 0x3 0xcb072039 0x1000000 0xcd103 0x5000500 0x0 0x3901 0x0 0xcd20305 0x30000 0x0 0x390100 0xc 0xd3030504 0x5000000 0x0 0x39010000 0xcd4 0x3050403 0x0 0x39 0x1000000 0x6f055 0xaa520806 0x39010000 0x3b0 0x2e2e3901 0x0 0x3b12e2e 0x39010000 0x3b2 0x2e2e3901 0x0 0x3b32e09 0x39010000 0x3b4 0xb233901 0x0 0x3b51d1f 0x39010000 0x3b6 0x11173901 0x0 0x3b71319 0x39010000 0x3b8 0x1033901 0x0 0x3b92e2e 0x39010000 0x3ba 0x2e2e3901 0x0 0x3bb0200 0x39010000 0x3bc 0x18123901 0x0 0x3bd1610 0x39010000 0x3be 0x1e1c3901 0x0 0x3bf220a 0x39010000 0x3c0 0x82e3901 0x0 0x3c12e2e 0x39010000 0x3c2 0x2e2e3901 0x0 0x3c32e2e 0x39010000 0x3e5 0x25243901 0x0 0x3c42e2e 0x39010000 0x3c5 0x2e2e3901 0x0 0x3c62e2e 0x39010000 0x3c7 0x2e023901 0x0 0x3c80024 0x39010000 0x3c9 0x1e1c3901 0x0 0x3ca1812 0x39010000 0x3cb 0x16103901 0x0 0x3cc0a08 0x39010000 0x3cd 0x2e2e3901 0x0 0x3ce2e2e 0x39010000 0x3cf 0x90b3901 0x0 0x3d01117 0x39010000 0x3d1 0x13193901 0x0 0x3d21d1f 0x39010000 0x3d3 0x25013901 0x0 0x3d4032e 0x39010000 0x3d5 0x2e2e3901 0x0 0x3d62e2e 0x39010000 0x3d7 0x2e2e3901 0x0 0x3e62223 0x39010000 0x6d8 0x0 0x390100 0x6 0xd9000000 0x3901 0x0 0x2e70039 0x1000000 0x251ff 0x39010000 0x253 0x2c390100 0x2 0x55013901 0x0 0x5ffaa55 0x25013901 0x0 0x26f1639 0x1000000 0x2f710 0x39010000 0x5ff 0xaa552500 0x39010000 0x6ff 0x55aa5208 0x4390100 0x4 0xc2806000 0x39010000 0x6ff 0x55aa5208 0x390100 0x2 0xc8800501 0xc800 0x2110005 0x1000078 0x22900>;
				qcom,mdss-dsi-off-command = [05 01 00 00 32 00 02 28 00 05 01 00 00 78 00 02 10 00];
				qcom,mdss-dsi-on-command-state = "dsi_lp_mode";
				qcom,mdss-dsi-off-command-state = "dsi_hs_mode";
				qcom,mdss-dsi-cabc-off-command = [15 01 00 00 10 00 02 55 00 05 01 00 00 10 00 02 29 00];
				qcom,mdss-dsi-cabc-ui-command = [15 01 00 00 10 00 02 55 01 05 01 00 00 10 00 02 29 00];
				qcom,mdss-dsi-cabc-still-image-command = [15 01 00 00 10 00 02 55 02 05 01 00 00 10 00 02 29 00];
				qcom,mdss-dsi-cabc-video-command = [15 01 00 00 10 00 02 55 03 05 01 00 00 10 00 02 29 00];
				qcom,mdss-dsi-panel-status-command = [06 01 00 01 05 00 02 0a 08];
				qcom,mdss-dsi-panel-status-command-state = "dsi_lp_mode";
				qcom,mdss-dsi-panel-status-check-mode = "reg_read";
				qcom,mdss-dsi-panel-status-value = <0x9c>;
				qcom,mdss-dsi-tx-eot-append;
				qcom,mdss-dsi-h-sync-pulse = <1>;
				qcom,mdss-dsi-lp11-init;
				qcom,mdss-dsi-init-delay-us = <50000>;
				qcom,mdss-dsi-traffic-mode = "burst_mode";
				qcom,mdss-dsi-lane-map = "lane_map_0123";
				qcom,mdss-dsi-bllp-eof-power-mode;
				qcom,mdss-dsi-bllp-power-mode;
				qcom,mdss-dsi-hfp-power-mode;
				qcom,mdss-dsi-hbp-power-mode;
				qcom,mdss-dsi-hsa-power-mode;
				qcom,mdss-dsi-lane-0-state;
				qcom,mdss-dsi-lane-1-state;
				qcom,mdss-dsi-lane-2-state;
				qcom,mdss-dsi-panel-timings = <0xe2302000 0x5c622434 0x26030400>;
				qcom,mdss-dsi-t-clk-post = <0x4>;
				qcom,mdss-dsi-t-clk-pre = <0x29>;
				qcom,mdss-dsi-bl-min-level = <1>;
				qcom,mdss-dsi-bl-max-level = <255>;
				qcom,mdss-dsi-dma-trigger = "trigger_sw";
				qcom,mdss-dsi-mdp-trigger = <0>;
				qcom,mdss-dsi-bl-pmic-control-type = "bl_ctrl_wled";
				qcom,mdss-dsi-reset-sequence = <1 10>, <0 1>, <1 15>;
				qcom,mdss-pan-physical-width-dimension = <62>;
				qcom,mdss-pan-physical-height-dimension = <110>;
				qcom,cont-splash-enabled;
				qcom,esd-check-enabled;
			};
};

